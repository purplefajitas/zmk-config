## config/boards/shields/w_preonic/Kconfig.defconfig
```kconfig
# Copyright (c) 2021 The ZMK Contributors
# SPDX-License-Identifier: MIT

if SHIELD_WPREONIC

config ZMK_KEYBOARD_NAME
    default "w_preonic"

endif
```

## config/boards/shields/w_preonic/Kconfig.shield
```kconfig
# Copyright (c) 2021 The ZMK Contributors
# SPDX-License-Identifier: MIT

config SHIELD_WPREONIC
    def_bool $(shields_list_contains,w_preonic)
```

## config/boards/shields/w_soyuz/Kconfig.defconfig
```kconfig
# Copyright (c) 2021 The ZMK Contributors
# SPDX-License-Identifier: MIT

if SHIELD_WSOYUZ

config ZMK_KEYBOARD_NAME
    default "w_soyuz"

endif
```

## config/boards/shields/w_soyuz/Kconfig.shield
```kconfig
# Copyright (c) 2021 The ZMK Contributors
# SPDX-License-Identifier: MIT

config SHIELD_WSOYUZ
    def_bool $(shields_list_contains,w_soyuz)
```

## config/boards/w_arisu_ph/Kconfig.defconfig
```kconfig
# Copyright (c) 2020 The ZMK Contributors
# SPDX-License-Identifier: MIT

if SHIELD_WARISUPH

config ZMK_KEYBOARD_NAME
    default "w_arisu_ph"

endif
```

## config/boards/w_arisu_ph/Kconfig.shield
```kconfig
# Copyright (c) 2020 The ZMK Contributors
# SPDX-License-Identifier: MIT

config SHIELD_WARISUPH
    def_bool $(shields_list_contains,w_arisu_ph)
```
